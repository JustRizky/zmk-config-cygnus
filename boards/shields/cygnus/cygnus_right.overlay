#include "cygnus.dtsi" // The shared dtsi file is included in the overlay

// Label of the kscan node in the dtsi
&kscan0 {
    col-gpios
        = <&pro_micro 14 (GPIO_ACTIVE_HIGH | GPIO_PULL_UP)>
        , <&pro_micro 15 (GPIO_ACTIVE_HIGH | GPIO_PULL_UP)>
        , <&pro_micro 18 (GPIO_ACTIVE_HIGH | GPIO_PULL_UP)>
        , <&pro_micro 19 (GPIO_ACTIVE_HIGH | GPIO_PULL_UP)>
        , <&pro_micro 20 (GPIO_ACTIVE_HIGH | GPIO_PULL_UP)>
        ;
    debounce-press-ms = <15>;
    debounce-release-ms = <15>;
};


&default_transform {
    col-offset = <5>;
};
